## Core/Modified_OpenSource/Kernel_5_Config-ARM-AST2600-AST2600EVB-src/kernel_tz.its
```
/dts-v1/;

/ {
	description = "AS2600 OP-TEE FIT Image";
	#address-cells = <1>;

	images {
		kernel-1 {
			description = "Linux kernel";
			data = /incbin/("arch/arm/boot/zImage");
			type = "kernel";
			arch = "arm";
			os = "linux";
			compression = "none";
			load = <0x80008000>;
			entry = <0x80008000>;
			hash-1 {
				algo = "sha256";
			};
		};
		optee-1 {
			description = "OP-TEE";
			data = /incbin/("../../optee/optee_os/out/arm/core/tee.bin");
			type = "kernel";
			arch = "arm";
			os = "linux";
			compression = "none";
			load = <0xa0ffffe4>;
			entry = <0xa1000000>;
			hash-1 {
				algo = "sha256";
			};
		};
		fdt@ast2600evb_a1.dtb {
			description = "Flattened Device Tree";
			data = /incbin/("arch/arm/boot/dts/ast2600evb_a1.dtb");
			type = "flat_dt";
			arch = "arm";
			compression = "none";

			hash-1 {
				algo = "sha256";
			};
		};
	};

	configurations {
		default = "conf@ast2600evb_a1.dtb";
		conf@ast2600evb_a1.dtb {
			description = "OP-TEE -> Kernel";
			kernel = "optee-1";
			loadables = "kernel-1";
			fdt = "fdt@ast2600evb_a1.dtb";

			hash-1 {
				algo = "sha256";
			};
		};
	};

};
```
